## BR/ext/Config.in
```kconfig
source "$BR2_EXTERNAL_E2B_MINI_PATH/package/fpga-module/Config.in"
source "$BR2_EXTERNAL_E2B_MINI_PATH/package/test/Config.in"
```

## BR/ext/package/fpga-module/Config.in
```kconfig
config BR2_PACKAGE_FPGA_MODULE
	bool "fpga-module"
	depends on BR2_LINUX_KERNEL
	help
          my first module

          http://www.nowhere

comment "fpga-module needs a Linux kernel to be built"
	depends on !BR2_LINUX_KERNEL
```

## BR/ext/package/test/Config.in
```kconfig
config BR2_PACKAGE_TEST
	bool "test"
	depends on BR2_LINUX_KERNEL
	help

          http://www.nowhere

comment "test needs a Linux kernel to be built"
	depends on !BR2_LINUX_KERNEL
```
